## config/west.yml
```yaml
manifest:
  remotes:
    - name: Eudoha
      url-base: https://github.com/Eudoha
    - name: kumamuk-git
      url-base: https://github.com/kumamuk-git
  projects:
    - name: zmk
      remote: Eudoha
      revision: main
      import: app/west.yml
    - name: zmk-pmw3610-driver
      remote: kumamuk-git
      revision: main
  self:
    path: config
```
